## Kconfig
```kconfig
mainmenu "Zeal 8-bit OS Configuration"

    config CPU_FREQ
        int "CPU Clock Frequency (Hz)"
        default 10000000
        help
            Defines the CPU frequency in Hz, this may be used for counting time when no hardware timer
            is available.

    config TARGET
        string
        default "zeal8bit" if TARGET_ZEAL_8_BIT
        default "trs80" if TARGET_TRS_80
        default "agon" if TARGET_AGON_LIGHT

    choice COMPILATION_TARGET
        prompt "Target board"
        help
            Choose the compilation target.

        config TARGET_ZEAL_8_BIT
            bool
            prompt "Zeal 8-bit computer"
            help
                Compile for Zeal 8-bit computer.

        config TARGET_TRS_80
            bool
            prompt "TRS-80 Model I"
            help
                Compile for TRS-80 Model I.

        config TARGET_AGON_LIGHT
            bool
            prompt "Agon Light"
            help
                Compile for Agon Light.
    endchoice

    # Configuration options depending on the target
    if TARGET_ZEAL_8_BIT
        source "target/zeal8bit/Kconfig"
    endif

    if TARGET_TRS_80
        source "target/trs80/Kconfig"
    endif

    if TARGET_AGON_LIGHT
        source "target/agon/Kconfig"
    endif

    source "kernel/Kconfig"
    source "romdisk/Kconfig"
```

## kernel/Kconfig
```kconfig
menu "Kernel configuration"

        config KERNEL_TARGET_HAS_MMU
                bool
                prompt "Enable MMU support in the kernel" if TARGET_HAS_MMU
                default n
                help
                        Boolean to mark whether the target has an MMU/Memory Mapper. If this option is selected,
                        the target needs to have a memory mapping organized as 4 pages of 16KB. Each page can be
                        mapped to any 16KB of physical address space.
                        As such, when enabled, the target must implement an `mmu_h.asm` interface.

        config KERNEL_REPRODUCIBLE_BUILD
                bool "Generate a reproducible binary"
                default n
                help
                        When this option is enabled, compiling the project several times with
                        the same configuration will produce the exact same binary. Thus, information
                        like build time will be excluded from the binary.

        config KERNEL_STACK_ADDR
                hex "Kernel stack virtual address"
                default 0xFFFF
                range 0x0000 0xFFFF
                help
                        After initializing the MMU, the kernel will set the Stack Pointer (SP).
                        This value defines the top of the stack in the virtual memory. It is highly
                        advised to use the top of the usable RAM.
                        If the kernel has MMU support, this value will also be the user stack address.
                        Else, the user stack address will be KERNEL_BSS address minus 1.

        config KERNEL_RAM_START
                hex
                prompt "Kernel RAM start address" if !KERNEL_TARGET_HAS_MMU
                default 0xC000
                range 0x0000 0xFFFF
                help
                        When the kernel has no MMU support, this value must be set to beginning of the kernel usable RAM.
                        This space ends at KERNEL_STACK_ADDR. It will containt he BSS, drivers RAM and kernel stack.
                        The user programs stack will be set the the KERNEL_RAM_START - 1.
                        When the kernel has MMU support, this is not required as the kernel will take a whole a whole
                        virtual page: 16KB.

        config KERNEL_COLDBOOT_HOOK
                bool
                # If the target has already a hook installed, do not show this option
                prompt "Hook routine at coldboot" if !TARGET_HAS_COLDBOOT_HOOK
                default TARGET_HAS_COLDBOOT_HOOK
                help
                        When enabled, the kernel will call the routine named `target_coldboot` right
                        after initializing the MMU (if any) and setting up the stack.
                        This routine must be defined in the target code.

        config KERNEL_EXIT_HOOK
                bool
                prompt "Hook routine at program exit" if !TARGET_HAS_EXIT_HOOK
                default TARGET_HAS_EXIT_HOOK
                help
                        When enabled, the kernel will call the routine named `target_exit` right
                        after exiting a user program.
                        This routine must be defined in the target code.

        config KERNEL_DRIVERS_HOOK
                bool
                prompt "Hook routine called after drivers initialization" if !TARGET_HAS_DRIVERS_HOOK
                default TARGET_HAS_DRIVERS_HOOK
                help
                        When enabled, the kernel will call the routine named `target_drivers_hook` right
                        after the drivers initialization.
                        This routine must be defined in the target code.

        config KERNEL_MAX_NESTED_PROGRAMS
                int "Maximum number of nested programs"
                depends on KERNEL_TARGET_HAS_MMU
                default 3
                range 1 10
                help
                        When a program A performs an exec syscall to load program B in memory, it is possible
                        to save A so that it is resumed once B finishes executing.
                        This value represents the maximum depth of exec that can be performed recursively by
                        programs.
                        For example, if this value is set to 1, no program can be saved in RAM when performing an exec.
                        If this value is set to 2, A can exec B, but B cannot exec without being overwritten/covered.

        config KERNEL_MAX_LOADED_DRIVERS
                int "Maximum number of loaded drivers"
                default 16
                range 0 255
                help
                        Maximum number of drivers that can be loaded into the kernel.
                        This is valid for both loaded drivers at compile time and at runtime.
                        Must be a power of 2.

        config KERNEL_MAX_OPENED_DEVICES
                int "Maximum number of opened devices"
                default 16
                range 16 128
                help
                        Maximum number of opened devices for a program. This includes opened
                        drivers as well as opened files.

        config KERNEL_MAX_OPENED_FILES
                int "Maximum number of opened files"
                default 16
                range 16 128
                help
                        Maximum number of opened files at once. This only does not include opened
                        drivers.

        config KERNEL_PATH_MAX
                int "Maximum path length (files/directories)"
                default 128
                range 64 4096
                help
                        Maximum length of a single absolute file path. Incrementing this value will make
                        the kernel use more RAM.

        config KERNEL_INIT_EXECUTABLE_ADDR
                hex "Virtual address to load the initial program in"
                range 0x4000 0xFF00
                default 0x4000
                help
                        After the kernel has finished initializing all its components and its drivers,
                        it will load the KERNEL_INIT_EXECUTABLE in RAM. This constant defines the virtual
                        address where it will be loaded and executed from.

        config KERNEL_LOG_BOOT_MOUNTED_DISKS
                bool "Print the mounted disks in the boot banner"
                default y
                help
                        If this option is enabled, the kernel will print the disks that are mounted on boot.

        config KERNEL_ENABLE_ZEALFS_SUPPORT
                bool "Enable support for ZealFS file system"
                default y
                help
                        If this option is enabled, ZealFS support will be added to the kernel, thus, disks using
                        it can be mounted.
                        Disable this option if you don't have any disk using ZealFS or if you want to reduce
                        kernel size. (saves around 1.3KB)

        choice
            prompt "ZealFS version"
            depends on KERNEL_ENABLE_ZEALFS_SUPPORT
            default KERNEL_ZEALFS_V1
            help
                Select the version of ZealFS to use in the kernel. ZealFS v1 supports
                a maximum file system size of 64KB, while ZealFS v2 (experimental)
                supports up to 4GB.

            config KERNEL_ZEALFS_V1
                bool "ZealFS v1"
                help
                    Use ZealFS version 1, which supports file systems up to 64KB in size.

            config KERNEL_ZEALFS_V2
                bool "ZealFS v2 [EXPERIMENTAL]"
                help
                    Use ZealFS version 2, which supports file systems up to 4GB in size.
                    Note: This version is experimental and may not be stable.
        endchoice

        config KERNEL_ENABLE_MBR_SUPPORT
            bool "Enable MBR support"
            default n
            help
                If this option is enabled, the kernel will include support for reading and
                parsing Master Boot Record (MBR) partition tables. Disable this option if
                MBR support is not required to reduce kernel size.

endmenu
```

## romdisk/Kconfig
```kconfig
menu "Romdisk configuration"

    config KERNEL_INIT_EXECUTABLE
        string "Executable to launch on boot"
        default "A:/init.bin"
        help
            Executable to load and execute on after system boot

    config ROMDISK_OFFSET_PAGES
        int "ROMDISK offset from kernel (in 16KB pages)"
        default 1
        range -32 31
        help
            Defines the number of 16KB pages between the kernel base address
            and the ROMDISK image. The final ROMDISK physical address is computed as:

                ROMDISK_ADDRESS = kernel_phys_address + (ROMDISK_OFFSET_PAGES * 0x4000)

            A positive value places the ROMDISK *after* the kernel in flash (recommended!), while a negative value places it
            *before*.

    config EXTRA_ROMDISK_FILES
        string "Paths to extra files (space-separated)"
        default ""
        help
            Space-separated list of paths to additional files to include in the ROM disk.
            Example: "path/to/file1.bin path/to/file2.txt ../another/file.dat"

    config ROMDISK_INCLUDE_INIT_BIN
        bool
        prompt "Include init.bin"
        default y
        help
            Boolean to mark whether to include init.bin in the romdisk.
            If this option is selected, "init.bin" will be included on A:/

    config INITBIN_ENABLE_COREUTILS
        bool
        prompt "Enable zeal-coreutils"
        depends on ROMDISK_INCLUDE_INIT_BIN
        default n
        help
            Boolean to mark whether the user is including zeal-coreutils.
            If this option is selected, the "coreutils" commands will be ommited from
            the init.bin shell (ie; ls, cp, mkdir, rm, etc)

    config ROMDISK_IGNORE_HIDDEN
        bool
        prompt "Ignore hidden and dot files"
        default y
        help
            Boolean to mark whether to include hidden and dot files in the romdisk.
            If this option is selected, hidden and dot files will be omitted from A:/

endmenu
```

## target/agon/Kconfig
```kconfig
menu "Agon Light Configuration"

    # Assign a number to each target
    config TARGET_NUMBER
        int
        default 3

    config TARGET_HAS_MMU
        bool
        default n

    config TARGET_HAS_DRIVERS_HOOK
        bool
        default y

endmenu
```

## target/trs80/Kconfig
```kconfig
menu "TRS-80 Configuration"

    # Assign a number to each target
    config TARGET_NUMBER
        int
        default 2

    config TARGET_HAS_MMU
        bool
        default n

    config KERNEL_TARGET_HAS_MMU
        bool
        default n

endmenu
```
